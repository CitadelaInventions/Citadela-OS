// Generated by generate_font.py from Inter-Variable.ttf.
// Copyright 2020 The Inter Project Authors (https://github.com/rsms/inter).
// Licensed under SIL Open Font License 1.1; see OFL.txt.
// Source: https://github.com/google/fonts/tree/main/ofl/inter
#pragma once
#include <Arduino.h>

namespace CMonoFont {
struct Glyph {
    uint16_t offset;
    uint8_t width, height, advance;
    int8_t xOffset, yOffset;
};
struct KernPair { uint16_t key; int8_t adjustment; };
struct Face {
    const Glyph *glyphs;
    const uint8_t *bits;
    const KernPair *pairs;
    uint16_t pairCount;
};

static const uint8_t kSmallBits[] PROGMEM = {
    0x70, 0x70, 0x70, 0x70, 0x70, 0x70, 0x70, 0x70, 0x70, 0x70, 0x70, 0x70, 0x70, 0x70, 0x00, 0x00,
    0x20, 0xf0, 0xf0, 0x70, 0xe6, 0xe7, 0xe7, 0xe7, 0xe6, 0xe6, 0xc6, 0xc6, 0x06, 0x0c, 0x0e, 0x1c,
    0x0e, 0x1c, 0x0c, 0x18, 0x0c, 0x18, 0x7f, 0xfe, 0x7f, 0xff, 0x7f, 0xff, 0x1c, 0x38, 0x18, 0x30,
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    0xe1, 0xf8, 0x00, 0x70,
};
static const Glyph kSmallGlyphs[] PROGMEM = {
    {0, 0, 0, 7, 0, 0}, //  32 ' '
    {0, 4, 20, 8, 2, -20}, //  33 '!'
    {20, 8, 8, 13, 3, -20}, //  34 '"'
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    {3304, 14, 6, 18, 2, -11}, // 126 '~'
};
static const KernPair kSmallPairs[] PROGMEM = {
    {105, 4},
    {196, -1},
    {202, -2},
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    {9018, -1},
};
static const Face Small = {kSmallGlyphs, kSmallBits, kSmallPairs, 814};

static const uint8_t kLargeBits[] PROGMEM = {
    0x70, 0x78, 0x78, 0x78, 0x78, 0x78, 0x78, 0x78, 0x78, 0x78, 0x78, 0x78, 0x78, 0x78, 0x78, 0x78,
    0x78, 0x78, 0x78, 0x78, 0x78, 0x78, 0x78, 0x00, 0x00, 0x00, 0x20, 0x78, 0xf8, 0xfc, 0xf8, 0x70,
    0xe1, 0xc0, 0xe3, 0xc0, 0xe3, 0xc0, 0xe3, 0xc0, 0xe1, 0xc0, 0xe1, 0xc0, 0xe1, 0xc0, 0xe1, 0xc0,
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    0xf0, 0x7f, 0xf0, 0xe0, 0x3f, 0xf0, 0xe0, 0x1f, 0xe0, 0x00, 0x07, 0x80,
};
static const Glyph kLargeGlyphs[] PROGMEM = {
    {0, 0, 0, 10, 0, 0}, //  32 ' '
    {0, 6, 32, 10, 2, -32}, //  33 '!'
    {32, 10, 11, 18, 4, -32}, //  34 '"'
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    {7780, 21, 8, 27, 3, -16}, // 126 '~'
};
static const KernPair kLargePairs[] PROGMEM = {
    {105, 6},
    {196, -1},
    {202, -4},
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    {9018, -1},
};
static const Face Large = {kLargeGlyphs, kLargeBits, kLargePairs, 942};

inline int kern(const Face &face, unsigned char left, unsigned char right) {
    if (left < 32 || left > 126 || right < 32 || right > 126) return 0;
    const uint16_t key = (left - 32) * 95 + right - 32;
    int lo = 0, hi = face.pairCount;
    while (lo < hi) {
        const int mid = (lo + hi) >> 1;
        if (face.pairs[mid].key < key) lo = mid + 1;
        else hi = mid;
    }
    return lo < face.pairCount && face.pairs[lo].key == key ?
        face.pairs[lo].adjustment : 0;
}

// x is the left edge; baseline is the common baseline for all glyphs.
// scaleX corrects the narrow horizontal pixel aspect of PAL super mode.
template<class Display>
inline int draw(Display &display, int x, int baseline, const char *text,
                const Face &face = Small, bool white = true,
                int tracking = 1, int scaleX = 1) {
    if (scaleX < 1) scaleX = 1;
    unsigned char previous = 0;
    for (; *text; ++text) {
        const unsigned char code = static_cast<unsigned char>(*text);
        if (code < 32 || code > 126) { previous = 0; continue; }
        if (previous) x += kern(face, previous, code) * scaleX;
        const Glyph &g = face.glyphs[code - 32];
        const int stride = (g.width + 7) >> 3;
        for (int row = 0; row < g.height; ++row) {
            const int offset = g.offset + row * stride;
            for (int col = 0; col < g.width; ++col) {
                if (!(pgm_read_byte(face.bits + offset + (col >> 3)) &
                      (0x80u >> (col & 7)))) continue;
                const int px = x + (g.xOffset + col) * scaleX;
                const int py = baseline + g.yOffset + row;
                if (scaleX == 1) display.mono1Pixel(px, py, white);
                else display.mono1FillRect(px, py, scaleX, 1, white);
            }
        }
        x += (g.advance + tracking) * scaleX;
        previous = code;
    }
    return x;
}
inline int measure(const char *text, const Face &face = Small,
                   int tracking = 1, int scaleX = 1) {
    if (scaleX < 1) scaleX = 1;
    int width = 0;
    unsigned char previous = 0;
    for (; *text; ++text) {
        const unsigned char code = static_cast<unsigned char>(*text);
        if (code < 32 || code > 126) { previous = 0; continue; }
        if (previous) width += kern(face, previous, code) * scaleX;
        width += (face.glyphs[code - 32].advance + tracking) * scaleX;
        previous = code;
    }
    return width;
}
} // namespace CMonoFont
